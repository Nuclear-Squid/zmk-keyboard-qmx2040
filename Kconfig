## Kconfig
```kconfig
config ZMK_BEHAVIOR_NUMPAD
  bool
  default y
  depends on DT_HAS_ZMK_BEHAVIOR_NUMPAD_ENABLED
  select ZMK_HID_INDICATORS  # Needed by the behavior to be able
                             # to poll the state of numlock
```

## boards/ergonautes/quaxe/Kconfig.defconfig
```kconfig
if BOARD_QUAXE
    config ZMK_KEYBOARD_NAME
        default "Quaxe"

    config RP2_FLASH_W25Q080
        default y
endif
```

## dts/bindings/behaviors/numpad.yaml
```yaml
description: Numpad behavior

compatible: "zmk,behavior-numpad"

include: one_param.yaml
```
